## esp32/main/Kconfig.projbuild
```kconfig
menu "MQTT Sensor Configuration"

    config WIFI_SSID
        string "WiFi SSID"
        default "myssid"
        help
            SSID (network name) for the device to connect to.

    config WIFI_PASSWORD
        string "WiFi Password"
        default "mypassword"
        help
            WiFi password (WPA or WPA2) for the device to use.

    config BROKER_URI
        string "MQTT Broker URI"
        default "mqtt://172.20.10.3:1883"
        help
            URL of the MQTT broker to connect to.
            Format: mqtt://host:port

    config SENSOR_TOPIC
        string "MQTT Sensor Data Topic"
        default "customer/1/location/1/device/1/sensor-data"
        help
            MQTT topic to publish sensor data to.

    config MQTT_USERNAME
        string "MQTT Username"
        default "user"
        help
            Username for MQTT broker authentication.

    config MQTT_PASSWORD
        string "MQTT Password"
        default "user"
        help
            Password for MQTT broker authentication.

endmenu
```

## main_esp/sdkconfig.defaults
```kconfig
CONFIG_ESP_WIFI_SOFTAP_SUPPORT=y

# Partition table - use Custom partition table to support 2MB flash
CONFIG_PARTITION_TABLE_CUSTOM=y
CONFIG_PARTITION_TABLE_CUSTOM_FILENAME="partitions.csv"
CONFIG_ESPTOOLPY_FLASHSIZE_4MB=y

# Bluetooth/BLE Configuration
CONFIG_BT_ENABLED=y
CONFIG_BT_NIMBLE_ENABLED=y
CONFIG_BT_CONTROLLER_ENABLED=y

# NimBLE settings
CONFIG_BT_NIMBLE_ROLE_PERIPHERAL=y
CONFIG_BT_NIMBLE_ROLE_BROADCASTER=y
CONFIG_BT_NIMBLE_MAX_CONNECTIONS=1

# Disable classic Bluetooth
CONFIG_BT_CLASSIC_ENABLED=n
CONFIG_BT_A2DP_ENABLE=n
CONFIG_BT_SPP_ENABLED=n

# Power Management
CONFIG_PM_ENABLE=y
CONFIG_FREERTOS_USE_TICKLESS_IDLE=y
CONFIG_PM_DFS_INIT_AUTO=y

# OTA Configuration
CONFIG_ESP_HTTPS_OTA_ALLOW_HTTP=y

CONFIG_ESP_WIFI_RX_IRAM_OPT=n
CONFIG_FREERTOS_TIMER_TASK_STACK_DEPTH=4096
```
